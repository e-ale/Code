/dts-v1/;
/plugin/;
/ {
	fragment@0 {
		target = <&spi1>;
		__overlay__ {
		       #address-cells = <1>;
		       #size-cells = <0>;
		       status = "okay";

			channel@0 {
				status = "disabled";
			};
			channel@1 {
				status = "disabled";
			};


		       mcp23s18@1 {
		               #address-cells = <1>;
		               #size-cells = <1>;
		               compatible = "microchip,mcp23s18";
		               gpio-controller;
		               microchip,spi-present-mask = <0x01>;
		               reg = <1>;
		               spi-max-frequency = <1000000>;
		       };
		};
	};
};
